## CMakeLists.txt
```
cmake_minimum_required(VERSION 3.20.0)

set(EXTRA_ZEPHYR_MODULES
    "${CMAKE_CURRENT_SOURCE_DIR}/../../../../modules/eerie_leap_common")

# Use Zephyr's build system
find_package(Zephyr REQUIRED HINTS $ENV{ZEPHYR_BASE})
project(test_guid_generator)

# Enable C++23
set(CMAKE_CXX_STANDARD 23)
set(CMAKE_CXX_STANDARD_REQUIRED ON)
set(CMAKE_CXX_EXTENSIONS OFF)

set(APP_SRC_DIR ${CMAKE_CURRENT_SOURCE_DIR}/../../../../app/src)
include_directories(${APP_SRC_DIR})

file(GLOB_RECURSE TEST_SOURCES src/*.c src/*.cpp)

# Add all source files to the app target
target_sources(app PRIVATE
  ${TEST_SOURCES}
)
```

## prj.conf
```kconfig
CONFIG_ZTEST=y

# Language and Compiler
CONFIG_CPP=y
CONFIG_PICOLIBC=y
CONFIG_STD_CPP2B=y
CONFIG_REQUIRES_FULL_LIBCPP=y
CONFIG_CPP_EXCEPTIONS=y
CONFIG_CPP_RTTI=y

# Logging And Debugging
CONFIG_THREAD_ANALYZER=y
CONFIG_THREAD_RUNTIME_STATS=y
CONFIG_THREAD_NAME=y
CONFIG_SYS_HEAP_RUNTIME_STATS=y
CONFIG_TIMING_FUNCTIONS=y

# Memory
CONFIG_HEAP_MEM_POOL_SIZE=100000

CONFIG_EERIE_LEAP_RT_CORE=y
CONFIG_EERIE_LEAP_TIME=y
```

## src/time.cpp
```c
#include <chrono>
#include <memory>
#include <regex>

#include <zephyr/kernel.h>
#include <zephyr/ztest.h>

#include "subsys/time/time_helpers.hpp"
#include "subsys/time/i_time_provider.h"
#include "subsys/time/boot_elapsed_time_provider.h"

using namespace std::chrono;
using namespace eerie_leap::subsys::time;

ZTEST_SUITE(time, NULL, NULL, NULL, NULL, NULL);

ZTEST(time, test_GetFormattedString_not_empty) {
    std::shared_ptr<ITimeProvider> time_provider = std::make_shared<BootElapsedTimeProvider>();
    auto current_time = time_provider->GetTime();

    auto formatted_time = TimeHelpers::GetFormattedString(current_time);

    zassert_not_equal(formatted_time.size(), 0);
    const std::regex time_pattern(R"(\d{4}-\d{2}-\d{2} \d{2}:\d{2}:\d{2}.*)");
    zassert_true(std::regex_match(formatted_time, time_pattern));
}

ZTEST(time, test_GetCurrentTime_returns_valid_elapsed_time) {
    std::shared_ptr<ITimeProvider> time_provider = std::make_shared<BootElapsedTimeProvider>();

    auto current_time1 = time_provider->GetTime();
    k_msleep(1);
    auto current_time2 = time_provider->GetTime();

    zassert_true(current_time2 - current_time1 >= 1ms);
    zassert_true(current_time2 - current_time1 <= 2ms);
}
```
