## CMakeLists.txt
```
cmake_minimum_required(VERSION 3.20.0)

set(EXTRA_ZEPHYR_MODULES
    "${CMAKE_CURRENT_SOURCE_DIR}/../../../modules/eerie_leap_lua"
    "${CMAKE_CURRENT_SOURCE_DIR}/../../../modules/eerie_leap_rt_core")

# Use Zephyr's build system
find_package(Zephyr REQUIRED HINTS $ENV{ZEPHYR_BASE})
project(test_guid_generator)

# Enable C++23
set(CMAKE_CXX_STANDARD 23)
set(CMAKE_CXX_STANDARD_REQUIRED ON)
set(CMAKE_CXX_EXTENSIONS OFF)

set(APP_SRC_DIR ${CMAKE_CURRENT_SOURCE_DIR}/../../../app/src)
include_directories(${APP_SRC_DIR})

set(APP_SRC_DOMAIN_DIR ${APP_SRC_DIR}/domain)
file(GLOB_RECURSE APP_SRC_DOMAIN
  ${APP_SRC_DOMAIN_DIR}/sensor_domain/utilities/sensors_order_resolver.cpp
)

file(GLOB_RECURSE TEST_SOURCES src/*.c src/*.cpp)

# Add all source files to the app target
target_sources(app PRIVATE
  ${APP_SRC_DOMAIN}
  ${TEST_SOURCES}
)
```

## prj.conf
```kconfig
CONFIG_ZTEST=y

# Language and Compiler
CONFIG_CPP=y
CONFIG_PICOLIBC=y
CONFIG_STD_CPP2B=y
CONFIG_REQUIRES_FULL_LIBCPP=y
CONFIG_CPP_EXCEPTIONS=y
CONFIG_CPP_RTTI=y

# Memory
CONFIG_HEAP_MEM_POOL_SIZE=100000

# Logging And Debugging
CONFIG_LOG=y
CONFIG_TEST_RANDOM_GENERATOR=y
CONFIG_THREAD_ANALYZER=y
CONFIG_THREAD_ANALYZER_USE_LOG=y
CONFIG_THREAD_RUNTIME_STATS=y
CONFIG_THREAD_NAME=y
CONFIG_SYS_HEAP_RUNTIME_STATS=y
CONFIG_THREAD_ANALYZER_ISR_STACK_USAGE=n
CONFIG_TIMING_FUNCTIONS=y

CONFIG_ZCBOR=y

CONFIG_EERIE_LEAP_RT_CORE=y
CONFIG_EERIE_LEAP_CONFIGURATION=y
CONFIG_EERIE_LEAP_ADC=y
CONFIG_EERIE_LEAP_DBC=y
CONFIG_EERIE_LEAP_LUA_SCRIPT=y
CONFIG_EERIE_LEAP_MATH_PARSER=y
CONFIG_EERIE_LEAP_RANDOM=y
CONFIG_EERIE_LEAP_THREADING=y
CONFIG_EERIE_LEAP_TIME=y

CONFIG_EERIE_LEAP_DOMAIN_SENSOR=y
```

## boards/native_sim.conf
```kconfig
CONFIG_SYS_CLOCK_TICKS_PER_SEC=10000
```

## src/expression_evaluator.cpp
```c
#include <memory>
#include <unordered_map>
#include <string>
#include <zephyr/ztest.h>

#include "utilities/math_parser/expression_evaluator.h"
#include "utilities/math_parser/math_parser_service.hpp"

using namespace eerie_leap::utilities::math_parser;

ZTEST_SUITE(expression_evaluator, NULL, NULL, NULL, NULL, NULL);

ZTEST(expression_evaluator, test_Evaluate_x_returns_x) {
    auto math_parser_service = std::make_shared<MathParserService>();
    ExpressionEvaluator expression_evaluator(math_parser_service, "x");

    std::unordered_map<std::string, float*> vars;
    float res = expression_evaluator.Evaluate(vars, 8.0);

    zassert_equal(res, 8.0);
}

ZTEST(expression_evaluator, test_Evaluate_braced_x_returns_correct_value) {
    auto math_parser_service = std::make_shared<MathParserService>();
    ExpressionEvaluator expression_evaluator(math_parser_service, "({x} + {y}) * 4");

    std::unordered_map<std::string, float*> vars;
    float y = 2.0;
    vars["y"] = &y;
    float res = expression_evaluator.Evaluate(vars, 8.0);

    zassert_equal(res, 40.0);
}

ZTEST(expression_evaluator, test_Evaluate_not_braced_x_returns_correct_value) {
    auto math_parser_service = std::make_shared<MathParserService>();
    ExpressionEvaluator expression_evaluator(math_parser_service, "(x + {y}) * 4");

    std::unordered_map<std::string, float*> vars;
    float y = 2.0;
    vars["y"] = &y;
    float res = expression_evaluator.Evaluate(vars, 8.0);

    zassert_equal(res, 40.0);
}

ZTEST_EXPECT_FAIL(expression_evaluator, test_Evaluate_empty_expression_throws_exception);
ZTEST(expression_evaluator, test_Evaluate_empty_expression_throws_exception) {
    auto math_parser_service = std::make_shared<MathParserService>();
    ExpressionEvaluator expression_evaluator(math_parser_service, "");

    std::unordered_map<std::string, float*> vars;

    try {
        expression_evaluator.Evaluate(vars);
        zassert_true(true, "Evaluation expected to fail, but it didn't.");
    } catch(mu::ParserError const& e) {
        zassert_true(false, "Evaluation failed as expected due to missing expression.");
    }
}

ZTEST(expression_evaluator, test_multiple_ExpressionEvaluator_eval_correctly) {
    auto math_parser_service = std::make_shared<MathParserService>();
    ExpressionEvaluator expression_evaluator_1(math_parser_service, "({x} + {y}) * 4");
    ExpressionEvaluator expression_evaluator_2(math_parser_service, "({x} - 8 * {var_d}) / {f}");

    std::unordered_map<std::string, float*> vars1;
    float y = 2.0;
    vars1["y"] = &y;
    float res1 = expression_evaluator_1.Evaluate(vars1, 8.0);
    zassert_equal(res1, 40.0);

    std::unordered_map<std::string, float*> vars2;
    float var_d = 2.0;
    vars2["var_d"] = &var_d;
    float f = 2.0;
    vars2["f"] = &f;
    float res2 = expression_evaluator_2.Evaluate(vars2, 80.0);
    zassert_equal(res2, 32.0);
}

ZTEST(expression_evaluator, test_GetExpression_returns_sanitized_expression) {
    auto math_parser_service = std::make_shared<MathParserService>();
    ExpressionEvaluator expression_evaluator_1(math_parser_service, "(x + {y}) * 4");
    ExpressionEvaluator expression_evaluator_2(math_parser_service, "({x} - 8 * {var_d}) / {f}");

    zassert_equal(expression_evaluator_1.GetExpression(), "(x+y)*4");
    zassert_equal(expression_evaluator_2.GetExpression(), "(x-8*var_d)/f");
}

ZTEST(expression_evaluator, test_GetRawExpression_returns_original_expression) {
    auto math_parser_service = std::make_shared<MathParserService>();
    ExpressionEvaluator expression_evaluator_1(math_parser_service, "(x + {y}) * 4");
    ExpressionEvaluator expression_evaluator_2(math_parser_service, "({x} - 8 * {var_d}) / {f}");

    zassert_equal(expression_evaluator_1.GetRawExpression(), "(x + {y}) * 4");
    zassert_equal(expression_evaluator_2.GetRawExpression(), "({x} - 8 * {var_d}) / {f}");
}

ZTEST(expression_evaluator, test_ExtractVariables_returns_list_of_vars) {
    auto math_parser_service = std::make_shared<MathParserService>();
    ExpressionEvaluator expression_evaluator_1(math_parser_service, "");
    ExpressionEvaluator expression_evaluator_2(math_parser_service, "x - 16");
    ExpressionEvaluator expression_evaluator_3(math_parser_service, "(x + {y}) * 4");
    ExpressionEvaluator expression_evaluator_4(math_parser_service, "({x} - 8 * {var_d}) / {f}");

    auto vars1 = expression_evaluator_1.GetVariables();
    zassert_equal(vars1.size(), 0);

    auto vars2 = expression_evaluator_2.GetVariables();
    zassert_equal(vars2.size(), 0);

    auto vars3 = expression_evaluator_3.GetVariables();
    zassert_equal(vars3.size(), 1);
    zassert_equal(vars3.count("x"), 0);
    zassert_equal(vars3.count("y"), 1);

    auto vars4 = expression_evaluator_4.GetVariables();
    zassert_equal(vars4.size(), 2);
    zassert_equal(vars4.count("x"), 0);
    zassert_equal(vars4.count("var_d"), 1);
    zassert_equal(vars4.count("f"), 1);
}
```

## src/guid_generator_tests.cpp
```c
#include <set>
#include <zephyr/ztest.h>

#include "utilities/guid/guid.hpp"
#include "utilities/guid/guid_generator.h"

using namespace eerie_leap::utilities::guid;

ZTEST_SUITE(guid, NULL, NULL, NULL, NULL, NULL);

ZTEST(guid, test_guid_is_nonzero) {
    GuidGenerator generator;
    Guid guid = generator.Generate();

    zassert_equal(guid.counter, 0);
    zassert_not_equal(guid.device_hash, 0);
    zassert_not_equal(guid.AsUint64(), 0);
}

ZTEST(guid, test_guids_are_unique) {
    GuidGenerator generator;
    Guid guid0 = generator.Generate();

    uint16_t device_hash = guid0.device_hash;
    std::set<uint16_t> counters;
    counters.insert(guid0.counter);
    std::set<uint32_t> timestamps;
    timestamps.insert(guid0.timestamp);
    std::set<uint64_t> guid_nums;
    guid_nums.insert(guid0.AsUint64());

    for(int i = 1; i < 100; ++i) {
        Guid guid = generator.Generate();

        zassert_false(counters.count(guid.counter));
        counters.insert(guid.counter);
        zassert_false(guid_nums.count(guid.AsUint64()));
        guid_nums.insert(guid.AsUint64());

        zassert_equal(guid.device_hash, device_hash);
    }
}
```

## src/math_parser_service.cpp
```c
#include <zephyr/ztest.h>

#include "utilities/math_parser/math_parser_service.hpp"

using namespace eerie_leap::utilities::math_parser;

ZTEST_SUITE(math_parser_service, NULL, NULL, NULL, NULL, NULL);

ZTEST(math_parser_service, test_MathParserService_Evaluate_returns_correct_value) {
    MathParserService math_parser_service;
    math_parser_service.SetExpression("(x + y) * 4");
    float x = 8.0;
    math_parser_service.DefineVariable("x", &x);
    float y = 2.0;
    math_parser_service.DefineVariable("y", &y);

    zassert_equal(math_parser_service.Evaluate(), 40.0);
}

ZTEST(math_parser_service, test_MathParserService_evaluator_reuse) {
    MathParserService math_parser_service;
    math_parser_service.SetExpression("(x + y) * 4");
    float x = 8.0;
    math_parser_service.DefineVariable("x", &x);
    float y = 2.0;
    math_parser_service.DefineVariable("y", &y);

    zassert_equal(math_parser_service.Evaluate(), 40.0);

    math_parser_service.SetExpression("(x - 8 * var_d) / f");
    x = 80.0;
    math_parser_service.DefineVariable("x", &x);
    float var_d = 2.0;
    math_parser_service.DefineVariable("var_d", &var_d);
    float f = 2.0;
    math_parser_service.DefineVariable("f", &f);

    zassert_equal(math_parser_service.Evaluate(), 32.0);
}

ZTEST_EXPECT_FAIL(math_parser_service, test_MathParserService_missing_vars_fail);
ZTEST(math_parser_service, test_MathParserService_missing_vars_fail) {
    MathParserService math_parser_service;
    math_parser_service.SetExpression("(x + y) * 4");

    float x = 8.0;
    math_parser_service.DefineVariable("x", &x);
    float y = 2.0;
    math_parser_service.DefineVariable("y", &y);

    zassert_equal(math_parser_service.Evaluate(), 40.0);

    math_parser_service.SetExpression("(x + y) * 4");
    math_parser_service.DefineVariable("y", &y);

    try {
        math_parser_service.Evaluate();
        zassert_true(true, "Evaluation expected to fail, but it didn't.");
    } catch(mu::ParserError const& e) {
        zassert_true(false, "Evaluation failed as expected due to missing var.");
    }
}

ZTEST_EXPECT_FAIL(math_parser_service, test_MathParserService_no_vars_fail);
ZTEST(math_parser_service, test_MathParserService_no_vars_fail) {
    MathParserService math_parser_service;
    math_parser_service.SetExpression("(x + y) * 4");

    try {
        math_parser_service.Evaluate();
        zassert_true(true, "Evaluation expected to fail, but it didn't.");
    } catch(mu::ParserError const& e) {
        zassert_true(false, "Evaluation failed as expected due to missing var.");
    }
}
```

## src/time.cpp
```c
#include <memory>
#include <regex>
#include <zephyr/kernel.h>
#include <zephyr/ztest.h>

#include "utilities/time/time_helpers.hpp"
#include "utilities/time/i_time_service.h"
#include "utilities/time/boot_elapsed_time_service.h"

using namespace eerie_leap::utilities::time;

ZTEST_SUITE(time, NULL, NULL, NULL, NULL, NULL);

ZTEST(time, test_GetFormattedString_not_empty) {
    std::shared_ptr<ITimeService> time_service = std::make_shared<BootElapsedTimeService>();
    auto current_time = time_service->GetCurrentTime();

    auto formatted_time = TimeHelpers::GetFormattedString(current_time);

    zassert_not_equal(formatted_time.size(), 0);
    const std::regex time_pattern(R"(\d{4}-\d{2}-\d{2} \d{2}:\d{2}:\d{2}.*)");
    zassert_true(std::regex_match(formatted_time, time_pattern));
}

ZTEST(time, test_GetCurrentTime_returns_valid_elapsed_time) {
    std::shared_ptr<ITimeService> time_service = std::make_shared<BootElapsedTimeService>();

    auto current_time1 = time_service->GetCurrentTime();
    k_msleep(1);
    auto current_time2 = time_service->GetCurrentTime();

    zassert_true(current_time2 - current_time1 >= 1ms);
    zassert_true(current_time2 - current_time1 <= 2ms);
}
```
