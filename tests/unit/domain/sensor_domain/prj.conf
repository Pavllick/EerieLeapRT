## CMakeLists.txt
```
cmake_minimum_required(VERSION 3.20.0)

# Use Zephyr's build system
find_package(Zephyr REQUIRED HINTS $ENV{ZEPHYR_BASE})
project(test_guid_generator)

# Enable C++23
set(CMAKE_CXX_STANDARD 23)
set(CMAKE_CXX_STANDARD_REQUIRED ON)
set(CMAKE_CXX_EXTENSIONS OFF)

set(APP_SRC_DIR ${CMAKE_CURRENT_SOURCE_DIR}/../../../../app/src)
include_directories(${APP_SRC_DIR})

# Path to muparser source and header
set(MUPARSER_SRC_DIR ${APP_SRC_DIR}/libs/muparser/src)
set(MUPARSER_INCLUDE_DIR ${APP_SRC_DIR}/libs/muparser/include)
file(GLOB_RECURSE MUPARSER_SOURCES ${MUPARSER_SRC_DIR}/*.cpp)
include_directories(${MUPARSER_INCLUDE_DIR})

set(APP_SRC_CONFIGURATION_DIR ${APP_SRC_DIR}/configuration)
file(GLOB_RECURSE APP_SRC_CONFIGURATION
  ${APP_SRC_CONFIGURATION_DIR}/*.c
  ${APP_SRC_CONFIGURATION_DIR}/*.cpp
)

set(APP_SRC_SUBSYS_DIR ${APP_SRC_DIR}/subsys)
file(GLOB_RECURSE APP_SRC_SUBSYS
  ${APP_SRC_SUBSYS_DIR}/random/*.cpp
  ${APP_SRC_SUBSYS_DIR}/adc/utilities/*.cpp
  ${APP_SRC_SUBSYS_DIR}/adc/models/*.cpp
)

set(APP_SRC_DOMAIN_DIR ${APP_SRC_DIR}/domain)
file(GLOB_RECURSE APP_SRC_DOMAIN
  ${APP_SRC_DOMAIN_DIR}/sensor_domain/utilities/*.cpp
  ${APP_SRC_DOMAIN_DIR}/sensor_domain/models/*.cpp
  ${APP_SRC_DOMAIN_DIR}/system_domain/utilities/*.cpp
  ${APP_SRC_DOMAIN_DIR}/system_domain/models/*.cpp
  ${APP_SRC_DOMAIN_DIR}/logging_domain/utilities/*.cpp
  ${APP_SRC_DOMAIN_DIR}/logging_domain/models/*.cpp
)

set(APP_SRC_UTILITIES_DIR ${APP_SRC_DIR}/utilities)
file(GLOB_RECURSE APP_SRC_UTILITIES
  ${APP_SRC_UTILITIES_DIR}/*.c
  ${APP_SRC_UTILITIES_DIR}/*.cpp
)

file(GLOB_RECURSE TEST_SOURCES src/*.c src/*.cpp)

# Add all source files to the app target
target_sources(app PRIVATE
  ${APP_SRC_CONFIGURATION}
  ${APP_SRC_SUBSYS}
  ${APP_SRC_DOMAIN}
  ${APP_SRC_UTILITIES}
  ${TEST_SOURCES}
  ${MUPARSER_SOURCES}
)
```

## Kconfig
```
menu "Zephyr"
source "Kconfig.zephyr"
endmenu

config EERIE_LEAP_HW_VERSION_MAJOR
	int "Hardware version major"
	range 0 255
	default 0

config EERIE_LEAP_HW_VERSION_MINOR
	int "Hardware version minor"
	range 0 255
	default 0

config EERIE_LEAP_HW_VERSION_PATCH
	int "Hardware version patch"
	range 0 65535
	default 0

config EERIE_LEAP_SW_VERSION_MAJOR
	int "Software version major"
	range 0 255
	default 0

config EERIE_LEAP_SW_VERSION_MINOR
	int "Software version minor"
	range 0 255
	default 0

config EERIE_LEAP_SW_VERSION_PATCH
	int "Software version patch"
	range 0 65535
	default 0

config EERIE_LEAP_ADC_VOLTAGE_MAX_MV
	int "ADC voltage max"
	default 3100

config EERIE_LEAP_SENSOR_VOLTAGE_MAX_MV
	int "Sensor voltage max"
	default 5000

config EERIE_LEAP_ADC_CALIBRATION_SAMPLES_COUNT
	int "ADC calibration samples count"
	default 2048

config EERIE_LEAP_ADC_CALIBRATION_SAMPLING_RATE_MS
	int "ADC calibration sampling rate ms"
	default 100
```

## prj.conf
```kconfig
CONFIG_ZTEST=y

# Language and Compiler
CONFIG_CPP=y
CONFIG_PICOLIBC=y
CONFIG_STD_CPP2B=y
CONFIG_REQUIRES_FULL_LIBCPP=y
CONFIG_CPP_EXCEPTIONS=y
CONFIG_CPP_RTTI=y

# Memory
CONFIG_HEAP_MEM_POOL_SIZE=100000

# Logging And Debugging
CONFIG_LOG=y
CONFIG_TEST_RANDOM_GENERATOR=y
CONFIG_THREAD_ANALYZER=y
CONFIG_THREAD_ANALYZER_USE_LOG=y
CONFIG_THREAD_RUNTIME_STATS=y
CONFIG_THREAD_NAME=y
CONFIG_SYS_HEAP_RUNTIME_STATS=y
CONFIG_THREAD_ANALYZER_ISR_STACK_USAGE=n
CONFIG_TIMING_FUNCTIONS=y

# FS Config
CONFIG_FLASH=y
CONFIG_FLASH_MAP=y
CONFIG_FILE_SYSTEM=y
CONFIG_FILE_SYSTEM_LITTLEFS=y
CONFIG_FILE_SYSTEM_MKFS=y

CONFIG_ZCBOR=y
CONFIG_JSON_LIBRARY=y
CONFIG_JSON_LIBRARY_FP_SUPPORT=y
```

## src/sensors_cbor_parser.cpp
```c
#include <zephyr/ztest.h>

#include "utilities/memory/heap_allocator.h"
#include "utilities/math_parser/math_parser_service.hpp"

#include "domain/sensor_domain/utilities/parsers/sensors_cbor_parser.h"
#include "domain/sensor_domain/models/sensor.h"
#include "utilities/voltage_interpolator/linear_voltage_interpolator.hpp"
#include "utilities/voltage_interpolator/cubic_spline_voltage_interpolator.hpp"

using namespace eerie_leap::utilities::memory;
using namespace eerie_leap::utilities::math_parser;

using namespace eerie_leap::domain::sensor_domain::utilities::parsers;
using namespace eerie_leap::domain::sensor_domain::models;
using namespace eerie_leap::domain::sensor_domain::utilities;
using namespace eerie_leap::utilities::voltage_interpolator;

ZTEST_SUITE(sensors_cbor_parser, NULL, NULL, NULL, NULL, NULL);

std::vector<std::shared_ptr<Sensor>> sensors_cbor_parser_GetTestSensors(std::shared_ptr<MathParserService> math_parser_service) {
    std::vector<CalibrationData> calibration_data_1 {
        {0.0, 0.0},
        {3.3, 100.0}
    };
    auto calibration_data_1_ptr = std::make_shared<std::vector<CalibrationData>>(calibration_data_1);

    ExpressionEvaluator expression_evaluator_1(math_parser_service, "{x} * 2 + {sensor_2} + 1");

    auto sensor_1 = std::make_shared<Sensor>("sensor_1");
    sensor_1->metadata = {
        .name = "Sensor 1",
        .unit = "km/h",
        .description = "Test Sensor 1"
    };
    sensor_1->configuration = {
        .type = SensorType::PHYSICAL_ANALOG,
        .channel = 0,
        .sampling_rate_ms = 1000,
        .voltage_interpolator = make_unique_ext<LinearVoltageInterpolator>(calibration_data_1_ptr),
        .expression_evaluator = make_unique_ext<ExpressionEvaluator>(expression_evaluator_1)
    };

    std::vector<CalibrationData> calibration_data_2 {
        {0.0, 0.0},
        {1.0, 29.0},
        {2.0, 111.0},
        {2.5, 162.0},
        {3.3, 200.0}
    };
    auto calibration_data_2_ptr = std::make_shared<std::vector<CalibrationData>>(calibration_data_2);

    ExpressionEvaluator expression_evaluator_2(math_parser_service, "x * 4 + 1.6");

    auto sensor_2 = std::make_shared<Sensor>("sensor_2");
    sensor_2->metadata = {
        .name = "Sensor 2",
        .unit = "km/h",
        .description = "Test Sensor 2"
    };
    sensor_2->configuration = {
        .type = SensorType::PHYSICAL_ANALOG,
        .channel = 1,
        .sampling_rate_ms = 500,
        .voltage_interpolator = make_unique_ext<CubicSplineVoltageInterpolator>(calibration_data_2_ptr),
        .expression_evaluator = make_unique_ext<ExpressionEvaluator>(expression_evaluator_2)
    };

    ExpressionEvaluator expression_evaluator_3(math_parser_service, "{sensor_1} + 8.34");

    auto sensor_3 = std::make_shared<Sensor>("sensor_3");
    sensor_3->metadata = {
        .name = "Sensor 3",
        .unit = "km/h",
        .description = "Test Sensor 3"
    };
    sensor_3->configuration = {
        .type = SensorType::VIRTUAL_ANALOG,
        .channel = std::nullopt,
        .sampling_rate_ms = 2000,
        .expression_evaluator = make_unique_ext<ExpressionEvaluator>(expression_evaluator_3)
    };

    auto sensor_4 = std::make_shared<Sensor>("sensor_4");
    sensor_4->metadata = {
        .name = "Sensor 4",
        .unit = "km/h",
        .description = "Test Sensor 4"
    };
    sensor_4->configuration = {
        .type = SensorType::PHYSICAL_ANALOG,
        .channel = 2,
        .sampling_rate_ms = 2000,
        .voltage_interpolator = make_unique_ext<CubicSplineVoltageInterpolator>(calibration_data_2_ptr)
    };

    std::vector<std::shared_ptr<Sensor>> sensors = {
        sensor_1, sensor_2, sensor_3, sensor_4 };

    return sensors;
}

ZTEST(sensors_cbor_parser, test_CborSerializeDeserialize) {
    auto math_parser_service = std::make_shared<MathParserService>();
    auto sensors_cbor_parser = std::make_shared<SensorsCborParser>(math_parser_service);

    auto sensors = sensors_cbor_parser_GetTestSensors(math_parser_service);

    auto serialized_sensors = sensors_cbor_parser->Serialize(sensors, 16, 16);
    auto deserialized_sensors = sensors_cbor_parser->Deserialize(*serialized_sensors.get());

    zassert_equal(deserialized_sensors.size(), sensors.size());

    for(size_t i = 0; i < sensors.size(); ++i) {
        std::shared_ptr<Sensor> deserialized_sensor = nullptr;
        for(size_t j = 0; j < deserialized_sensors.size(); ++j) {
            if(strcmp(deserialized_sensors[j]->id.c_str(), sensors[i]->id.c_str()) == 0) {
                deserialized_sensor = deserialized_sensors[j];
                break;
            }
        }
        zassert_true(deserialized_sensor != nullptr);

        zassert_true(deserialized_sensor->metadata.name == sensors[i]->metadata.name);
        zassert_true(deserialized_sensor->metadata.unit == sensors[i]->metadata.unit);
        zassert_true(deserialized_sensor->metadata.description == sensors[i]->metadata.description);

        zassert_true(deserialized_sensor->configuration.type == sensors[i]->configuration.type);
        if(deserialized_sensor->configuration.channel.has_value() && sensors[i]->configuration.channel.has_value()) {
            zassert_true(deserialized_sensor->configuration.channel.value() == sensors[i]->configuration.channel.value());
        } else {
            zassert_true(!deserialized_sensor->configuration.channel.has_value() && !sensors[i]->configuration.channel.has_value());
        }
        zassert_true(deserialized_sensor->configuration.sampling_rate_ms == sensors[i]->configuration.sampling_rate_ms);
        if(deserialized_sensor->configuration.voltage_interpolator != nullptr || sensors[i]->configuration.voltage_interpolator != nullptr)
            zassert_true(deserialized_sensor->configuration.voltage_interpolator->GetInterpolationMethod() == sensors[i]->configuration.voltage_interpolator->GetInterpolationMethod());
        if(deserialized_sensor->configuration.expression_evaluator != nullptr || sensors[i]->configuration.expression_evaluator != nullptr)
            zassert_true(deserialized_sensor->configuration.expression_evaluator->GetExpression() == sensors[i]->configuration.expression_evaluator->GetExpression());
    }
}
```

## src/sensors_json_parser.cpp
```c
#include <zephyr/ztest.h>

#include "utilities/memory/heap_allocator.h"
#include "utilities/math_parser/math_parser_service.hpp"
#include "utilities/voltage_interpolator/linear_voltage_interpolator.hpp"
#include "utilities/voltage_interpolator/cubic_spline_voltage_interpolator.hpp"

#include "domain/sensor_domain/utilities/parsers/sensors_json_parser.h"
#include "domain/sensor_domain/models/sensor.h"

using namespace eerie_leap::utilities::memory;
using namespace eerie_leap::utilities::math_parser;

using namespace eerie_leap::domain::sensor_domain::utilities::parsers;
using namespace eerie_leap::domain::sensor_domain::models;
using namespace eerie_leap::domain::sensor_domain::utilities;
using namespace eerie_leap::utilities::voltage_interpolator;

ZTEST_SUITE(sensors_json_parser, NULL, NULL, NULL, NULL, NULL);

std::vector<std::shared_ptr<Sensor>> sensors_json_parser_GetTestSensors(std::shared_ptr<MathParserService> math_parser_service) {
    std::vector<CalibrationData> calibration_data_1 {
        {0.0, 0.0},
        {3.3, 100.0}
    };
    auto calibration_data_1_ptr = std::make_shared<std::vector<CalibrationData>>(calibration_data_1);

    ExpressionEvaluator expression_evaluator_1(math_parser_service, "{x} * 2 + {sensor_2} + 1");

    auto sensor_1 = std::make_shared<Sensor>("sensor_1");
    sensor_1->metadata = {
        .name = "Sensor 1",
        .unit = "km/h",
        .description = "Test Sensor 1"
    };
    sensor_1->configuration = {
        .type = SensorType::PHYSICAL_ANALOG,
        .channel = 0,
        .sampling_rate_ms = 1000,
        .voltage_interpolator = make_unique_ext<LinearVoltageInterpolator>(calibration_data_1_ptr),
        .expression_evaluator = make_unique_ext<ExpressionEvaluator>(expression_evaluator_1)
    };

    std::vector<CalibrationData> calibration_data_2 {
        {0.0, 0.0},
        {1.0, 29.0},
        {2.0, 111.0},
        {2.5, 162.0},
        {3.3, 200.0}
    };
    auto calibration_data_2_ptr = std::make_shared<std::vector<CalibrationData>>(calibration_data_2);

    ExpressionEvaluator expression_evaluator_2(math_parser_service, "x * 4 + 1.6");

    auto sensor_2 = std::make_shared<Sensor>("sensor_2");
    sensor_2->metadata = {
        .name = "Sensor 2",
        .unit = "km/h",
        .description = "Test Sensor 2"
    };
    sensor_2->configuration = {
        .type = SensorType::PHYSICAL_ANALOG,
        .channel = 1,
        .sampling_rate_ms = 500,
        .voltage_interpolator = make_unique_ext<CubicSplineVoltageInterpolator>(calibration_data_2_ptr),
        .expression_evaluator = make_unique_ext<ExpressionEvaluator>(expression_evaluator_2)
    };

    ExpressionEvaluator expression_evaluator_3(math_parser_service, "{sensor_1} + 8.34");

    auto sensor_3 = std::make_shared<Sensor>("sensor_3");
    sensor_3->metadata = {
        .name = "Sensor 3",
        .unit = "km/h",
        .description = "Test Sensor 3"
    };
    sensor_3->configuration = {
        .type = SensorType::VIRTUAL_ANALOG,
        .channel = std::nullopt,
        .sampling_rate_ms = 2000,
        .expression_evaluator = make_unique_ext<ExpressionEvaluator>(expression_evaluator_3)
    };

    auto sensor_4 = std::make_shared<Sensor>("sensor_4");
    sensor_4->metadata = {
        .name = "Sensor 4",
        .unit = "km/h",
        .description = "Test Sensor 4"
    };
    sensor_4->configuration = {
        .type = SensorType::PHYSICAL_ANALOG,
        .channel = 2,
        .sampling_rate_ms = 2000,
        .voltage_interpolator = make_unique_ext<CubicSplineVoltageInterpolator>(calibration_data_2_ptr)
    };

    std::vector<std::shared_ptr<Sensor>> sensors = {
        sensor_1, sensor_2, sensor_3, sensor_4 };

    return sensors;
}

ZTEST(sensors_json_parser, test_JsonSerializeDeserialize) {
    auto math_parser_service = std::make_shared<MathParserService>();
    auto sensors_json_parser = std::make_shared<SensorsJsonParser>(math_parser_service);

    auto sensors = sensors_json_parser_GetTestSensors(math_parser_service);

    auto serialized_sensors = sensors_json_parser->Serialize(sensors, 16, 16);
    auto deserialized_sensors = sensors_json_parser->Deserialize(*serialized_sensors.get(), 16, 16);

    zassert_equal(deserialized_sensors.size(), sensors.size());

    for(size_t i = 0; i < sensors.size(); ++i) {
        std::shared_ptr<Sensor> deserialized_sensor = nullptr;
        for(size_t j = 0; j < deserialized_sensors.size(); ++j) {
            if(strcmp(deserialized_sensors[j]->id.c_str(), sensors[i]->id.c_str()) == 0) {
                deserialized_sensor = deserialized_sensors[j];
                break;
            }
        }
        zassert_true(deserialized_sensor != nullptr);

        zassert_true(deserialized_sensor->metadata.name == sensors[i]->metadata.name);
        zassert_true(deserialized_sensor->metadata.unit == sensors[i]->metadata.unit);
        zassert_true(deserialized_sensor->metadata.description == sensors[i]->metadata.description);

        zassert_true(deserialized_sensor->configuration.type == sensors[i]->configuration.type);
        if(deserialized_sensor->configuration.channel.has_value() && sensors[i]->configuration.channel.has_value()) {
            zassert_true(deserialized_sensor->configuration.channel.value() == sensors[i]->configuration.channel.value());
        } else {
            zassert_true(!deserialized_sensor->configuration.channel.has_value() && !sensors[i]->configuration.channel.has_value());
        }
        zassert_true(deserialized_sensor->configuration.sampling_rate_ms == sensors[i]->configuration.sampling_rate_ms);
        if(deserialized_sensor->configuration.voltage_interpolator != nullptr || sensors[i]->configuration.voltage_interpolator != nullptr)
            zassert_true(deserialized_sensor->configuration.voltage_interpolator->GetInterpolationMethod() == sensors[i]->configuration.voltage_interpolator->GetInterpolationMethod());
        if(deserialized_sensor->configuration.expression_evaluator != nullptr || sensors[i]->configuration.expression_evaluator != nullptr)
            zassert_true(deserialized_sensor->configuration.expression_evaluator->GetExpression() == sensors[i]->configuration.expression_evaluator->GetExpression());
    }
}
```
