## app/boards/qemu_cortex_a9.conf
```kconfig
CONFIG_FLASH_SIMULATOR=y
CONFIG_ADC_EMUL=y

# NOTE: QEMU Cortex-A9 CONFIG_NETWORKING seems to conflict with CONFIG_NET_QEMU_ETHERNET
# and leads to a kernel panic

# # Networking config
# CONFIG_NETWORKING=y
# CONFIG_NET_IPV4=y
# CONFIG_NET_IPV6=n
# CONFIG_NET_TCP=y
# CONFIG_NET_SOCKETS=y

# # Network address config
# CONFIG_NET_CONFIG_SETTINGS=y
# CONFIG_NET_CONFIG_NEED_IPV4=y
# CONFIG_NET_CONFIG_MY_IPV4_ADDR="192.0.2.1"
# CONFIG_NET_CONFIG_PEER_IPV4_ADDR="192.0.2.2"

# CONFIG_NET_L2_ETHERNET=y
# CONFIG_NET_QEMU_ETHERNET=y

# CONFIG_SLIP=n
# CONFIG_NET_SLIP_TAP=n

# CONFIG_NET_CONFIG_MY_IPV4_NETMASK="255.255.255.0"

# CONFIG_HTTP_SERVER=y
# CONFIG_HTTP_SERVER_WEBSOCKET=y
# CONFIG_HTTP_SERVER_MAX_CLIENTS=2
# CONFIG_HTTP_PARSER_URL=y
# CONFIG_HTTP_PARSER=y

# CONFIG_EVENTFD=y
```

## app/boards/qemu_cortex_m3.conf
```kconfig
# Memory Config
# 4 MB Flash
CONFIG_FLASH_SIZE=4096
# 512 KB RAM
CONFIG_SRAM_SIZE=512

# Simulation Config
CONFIG_QEMU_ICOUNT_SLEEP=y
```

## app/boards/qemu_x86_64.conf
```kconfig
CONFIG_FLASH_SIMULATOR=y
CONFIG_ADC_EMUL=y
CONFIG_GPIO_EMUL=y

CONFIG_POSIX_API=y

# Memory
# 8MB SRAM
CONFIG_SRAM_SIZE=8388608
# 2MB Heap
CONFIG_HEAP_MEM_POOL_SIZE=2097152
# 32MB VM Size
CONFIG_KERNEL_VM_SIZE=2000000

# CBF subsystem
CONFIG_CHARACTER_FRAMEBUFFER=y
```

## app/src/utilities/Kconfig
```kconfig
# Kconfig for Application Utilities

menuconfig APP_UTILITIES_KCONFIG
    bool "Application Utilities Configuration"
    default y

if APP_UTILITIES_KCONFIG

config APP_LOGGER_LOG_LEVEL
    int "Log level for the shared Logger" # Changed AppLogger to Logger
    default 4  # LOG_LEVEL_DBG
    help
      Sets the default compile-time log level for the shared 'logger' module
      used by the Logger class. # Changed AppLogger to Logger
      0=None, 1=Error, 2=Warning, 3=Info, 4=Debug.
      This also serves as the default runtime level, which can be
      further restricted by individual logger backends if runtime
      filtering is enabled.

endif # APP_UTILITIES_KCONFIG
```

## boards/eerieleap/esp32s3_pm_hw_02/Kconfig
```kconfig
# Copyright (c) 2025 Pavel Maloletkov
# SPDX-License-Identifier: Apache-2.0

config HEAP_MEM_POOL_ADD_SIZE_BOARD
	int
	default 4096 if BOARD_ESP32S3_DEVKITC_ESP32S3_PROCPU
	default 256 if BOARD_ESP32S3_DEVKITC_ESP32S3_APPCPU
```

## boards/eerieleap/esp32s3_pm_hw_02/board.yml
```yaml
board:
  name: esp32s3_pm_hw_02
  full_name: ESP32-S3-PM-HW-02
  vendor: eerieleap
  socs:
  - name: esp32s3
```

## boards/eerieleap/esp32s3_pm_hw_02/esp32s3_pm_hw_02_procpu_defconfig
```kconfig
# SPDX-License-Identifier: Apache-2.0

CONFIG_CONSOLE=y
CONFIG_SERIAL=y
CONFIG_UART_CONSOLE=y
CONFIG_GPIO=y
CONFIG_CLOCK_CONTROL=y

CONFIG_SPI=y
CONFIG_SDHC=y
CONFIG_DISK_DRIVERS=y
CONFIG_DISK_DRIVER_SDMMC=y
```

## boards/mcudev/devebox_stm32h743_hw_20/Kconfig.defconfig
```kconfig
if BOARD_DEVEBOX_STM32H743_HW_20

source "boards/common/usb/Kconfig.cdc_acm_serial.defconfig"

endif # BOARD_DEVEBOX_STM32H743_HW_20
```

## boards/mcudev/devebox_stm32h743_hw_20/board.yml
```yaml
board:
  name: devebox_stm32h743_hw_20
  full_name: MCUDev DevEBox STM32H743VIT6 Board HW 2.0
  vendor: mcudev
  socs:
    - name: stm32h743xx
```

## modules/lua_zephyr/Kconfig.lua_module
```kconfig
menu "Lua Zephyr"

config LUA
    bool "Lua support"
    help
      Enable Lua support. This is required for the Lua scripting engine.
      If you enable this option, you will be able to use Lua scripts.

module = LUA_ZEPHYR
module-str = lua_zephyr
source "subsys/logging/Kconfig.template.log_config"
endmenu
```

## tests/functional/controllers/testcase.yaml
```yaml
common:
  tags: controller
  platform_allow:
    - native_sim

tests:
  functional.controller: {}
```

## tests/functional/domain/adc_domain/testcase.yaml
```yaml
common:
  tags:
    - domain
    - adc_subsys
  platform_allow:
    - native_sim

tests:
  functional.adc_subsys: {}
```

## tests/functional/domain/fs_domain/testcase.yaml
```yaml
common:
  tags:
    - domain
    - fs_subsys
  platform_allow:
    - native_sim

tests:
  functional.fs_subsys: {}
```

## tests/functional/domain/sensor_domain/testcase.yaml
```yaml
common:
  tags:
    - domain
    - sensor_domain
  platform_allow:
    - native_sim

tests:
  functional.sensor_domain: {}
```

## tests/functional/utilities/logger/testcase.yaml
```yaml
tests:
  utilities.logger.functional:
    tags: utilities logger functional
    platform_allow: native_sim
    harness: console
    harness_config:
      type: multi_line
      ordered: true
      regex:
        - "MARKER_FORMAT_DEBUG_START"
        - ".*<dbg> logger: \\[FormatTest\\] Format: This is a debug message with number 123."
        - "MARKER_FORMAT_DEBUG_END"
        - "MARKER_FORMAT_INFO_START"
        - ".*<inf> logger: \\[FormatTest\\] Format: This is an info message with string 'hello'."
        - "MARKER_FORMAT_INFO_END"
        - "MARKER_FORMAT_WARNING_START"
        - ".*<wrn> logger: \\[FormatTest\\] Format: This is a warning message."
        - "MARKER_FORMAT_WARNING_END"
        - "MARKER_FORMAT_ERROR_START"
        - ".*<err> logger: \\[FormatTest\\] Format: This is an error message with float 3.14."
        - "MARKER_FORMAT_ERROR_END"

        - "MARKER_FILTER_DEBUG_START"
        - "MARKER_FILTER_DEBUG_END"

        - "MARKER_FILTER_INFO_START"
        - ".*<inf> logger: \\[FilterTest\\] Filter: This INFO message SHOULD be visible."
        - "MARKER_FILTER_INFO_END"
        - "MARKER_FILTER_WARNING_START"
        - ".*<wrn> logger: \\[FilterTest\\] Filter: This WARNING message SHOULD be visible."
        - "MARKER_FILTER_WARNING_END"
        - "MARKER_FILTER_ERROR_START"
        - ".*<err> logger: \\[FilterTest\\] Filter: This ERROR message SHOULD be visible."
        - "MARKER_FILTER_ERROR_END"

        - "MARKER_DEFAULT_DEBUG_START"
        - "MARKER_DEFAULT_DEBUG_END"

        - "MARKER_DEFAULT_INFO_START"
        - ".*<inf> logger: \\[DefaultOutputTest\\] DefaultOutput: Info message \\(should appear\\)."
        - "MARKER_DEFAULT_INFO_END"
        - "MARKER_DEFAULT_WARNING_START"
        - ".*<wrn> logger: \\[DefaultOutputTest\\] DefaultOutput: Warning message \\(should appear\\)."
        - "MARKER_DEFAULT_WARNING_END"
        - "MARKER_DEFAULT_ERROR_START"
        - ".*<err> logger: \\[DefaultOutputTest\\] DefaultOutput: Error message \\(should appear\\)."
        - "MARKER_DEFAULT_ERROR_END"

        - "===== AppLogger Test Suite Complete ====="
```

## tests/unit/domain/sensor_domain/testcase.yaml
```yaml
common:
  tags:
    - unit
    - domain
    - sensor_domain
    - unit_sensor_domain
  platform_allow:
    - native_sim

tests:
  unit.sensor_domain: {}
```

## tests/unit/subsys/math_parser/testcase.yaml
```yaml
common:
  tags: subsys.math_parser
  platform_allow:
    - native_sim

tests:
  unit.subsys.math_parser: {}
```

## tests/unit/subsys/mdf/testcase.yaml
```yaml
common:
  tags: subsys.mdf
  platform_allow:
    - native_sim

tests:
  unit.subsys.mdf: {}
```

## tests/unit/subsys/time/testcase.yaml
```yaml
common:
  tags: subsys.time
  platform_allow:
    - native_sim

tests:
  unit.subsys.time: {}
```

## tests/unit/utilities/testcase.yaml
```yaml
common:
  tags: utilities
  platform_allow:
    - native_sim

tests:
  unit.utilities: {}
```

## west.yml
```yaml
# Copyright (c) 2021 Nordic Semiconductor ASA
# SPDX-License-Identifier: Apache-2.0

manifest:
  self:
    west-commands: scripts/west-commands.yml

  remotes:
    - name: zephyrproject-rtos
      url-base: https://github.com/zephyrproject-rtos

  projects:
    - name: zephyr
      remote: zephyrproject-rtos
      revision: v4.1.0
      import:
        # By using name-allowlist we can clone only the modules that are
        # strictly needed by the application.
        name-allowlist:
          - cmsis           # required by the ARM port
          - mcuboot         # bootloader
          - esp32           # required by the esp32 board
          - hal_espressif   # required by the esp32 board
          - littlefs        # littleFS lightweight filesystem
```
